## prj.conf
```kconfig
CONFIG_GPIO=y
CONFIG_NVMEM=y
CONFIG_OTP=y
CONFIG_OTP_PROGRAM=y
CONFIG_FLASH=y
CONFIG_NVMEM_FLASH=y
CONFIG_NO_OPTIMIZATIONS=y
CONFIG_OTP_SHELL=y
CONFIG_LOG=y
CONFIG_SHELL=y
CONFIG_SHELL_PROMPT_UART="flash:~$ "
CONFIG_SHELL_BACKEND_SERIAL_INTERRUPT_DRIVEN=n
CONFIG_ASSERT=y
CONFIG_PRINTK=y
CONFIG_FLASH_SHELL=y
CONFIG_FLASH_SHELL_TEST_COMMANDS=y
CONFIG_FLASH_PAGE_LAYOUT=y
CONFIG_FLASH_EX_OP_ENABLED=y
CONFIG_FLASH_HAS_UNALIGNED_WRITE=y
```

## src/main.c
```c
/*
 * Copyright (c) 2016 Intel Corporation
 *
 * SPDX-License-Identifier: Apache-2.0
 */

#include <stdio.h>
#include <zephyr/kernel.h>
#include <zephyr/drivers/gpio.h>
#include <zephyr/drivers/otp.h>
#include <zephyr/nvmem.h>

/* 1000 msec = 1 sec */
#define SLEEP_TIME_MS 1000

/* The devicetree node identifier for the "led0" alias. */
#define LED0_NODE DT_ALIAS(led0)

/*
 * A build error on this line means your board is unsupported.
 * See the sample documentation for information on how to fix this.
 */
// static const struct gpio_dt_spec led = GPIO_DT_SPEC_GET(LED0_NODE, gpios);
static const struct nvmem_cell user_row =
	NVMEM_CELL_GET_BY_NAME(DT_NODELABEL(test_consumer0), user_row);
int main(void)
{
	// int ret;
	// bool led_state = true;

	// if (!gpio_is_ready_dt(&led)) {
	// 	return 0;
	// }

	// ret = gpio_pin_configure_dt(&led, GPIO_OUTPUT_ACTIVE);
	// if (ret < 0) {
	// 	return 0;
	// }

	// while (1) {
	// 	ret = gpio_pin_toggle_dt(&led);
	// 	if (ret < 0) {
	// 		return 0;
	// 	}

	// 	led_state = !led_state;
	// 	printf("LED state: %s\n", led_state ? "ON" : "OFF");
	// 	k_msleep(SLEEP_TIME_MS);
	// }
	uint8_t buf[20] = {0};
	int len = 4;
	int off = 0;
	otp_read(user_row.dev, user_row.offset + off, buf, len);
	for (int i = 0; i < 4; i++) {
		printf("0x%x\t", buf[i]);
	}

	buf[0] = 0x94;
	otp_program(user_row.dev, user_row.offset + off, buf, 1);

	otp_read(user_row.dev, user_row.offset + off, buf, len);
	for (int i = 0; i < 4; i++) {
		printf("\n0x%x\t", buf[i]);
	}
	return 0;
}
```
