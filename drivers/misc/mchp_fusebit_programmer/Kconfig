## drivers/misc/mchp_fusebit_programmer/Kconfig
```kconfig
# Copyright (c) 2026 Microhip Technology inc
# SPDX-License-Identifier: Apache-2.0

config MCHP_FUSEBIT_PROGRAMMER
	bool
	default y if DT_HAS_MICROCHIP_FUSEBIT_PROGRAMMER_ENABLED
```

## drivers/otp/Kconfig.mchp
```kconfig
# Copyright (c) 2026 Microchip Technologies Inc.
# SPDX-License-Identifier: Apache-2.0

config OTP_MCHP_NVM
	bool "Microchip NVM OTP driver"
	default y
	depends on DT_HAS_MICROCHIP_NVM_G1_OTP_ENABLED
	help
	  Enable driver for OTP regions inside embedded non-volatile memory
	  found in STM32 SoCs.

	  N.B.: the "program" operation is currently not supported.
```

## dts/bindings/misc/microchip,fusebit-programmer.yaml
```yaml
# Copyright (c) 2025 Nordic Semiconductor ASA
# SPDX-License-Identifier: Apache-2.0

description: IPC configuration for Nordic IronSide calls

compatible: "microchip,fusebit-programmer"

include: base.yaml

properties:
  memory-region:
    type: phandle
    required: true
    description: phandle to shared memory region
```
